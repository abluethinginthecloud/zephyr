## dts/bindings/display/shtdo,tr230s.yaml
```yaml
# SPDX-License-Identifier: Apache-2.0

compatible: "shtdo,tr230s"

description: |
  Shanghai Top Display Optoelectronics TR230S display bridge/controller.

  The supported host interface is MIPI DBI Type C using four-wire SPI. The
  WAIT input is the controller-ready flow-control signal and is sampled before
  each TR230S controller transaction.

include: [mipi-dbi-spi-device.yaml, display-controller.yaml]

properties:
  mipi-max-frequency:
    required: true

  mipi-mode:
    required: true

  wait-gpios:
    type: phandle-array
    required: true
    description: |
      Controller-ready input. The active logical state means that the TR230S
      can accept a new controller transaction.

  ready-timeout-ms:
    type: int
    default: 500
    description: |
      Maximum time to wait for the controller-ready signal. A value of zero
      waits indefinitely.

  reset-pre-delay-ms:
    type: int
    default: 0
    description: Delay before asserting hardware reset, in milliseconds.

  reset-pulse-ms:
    type: int
    default: 10
    description: Duration of the active hardware-reset pulse, in milliseconds.

  post-reset-delay-ms:
    type: int
    default: 0
    description: Delay after releasing hardware reset, in milliseconds.

  default-brightness:
    type: int
    default: 50
    description: Backlight duty percentage restored when blanking is disabled.
```
